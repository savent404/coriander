## CMakeLists.txt
```
#-------------------------------------------------------------------------------
# Zephyr Example Application
#
# Copyright (c) 2023 Savent Gate
# SPDX-License-Identifier: All rights reserved
#-------------------------------------------------------------------------------

option(UNIT_TEST "Build tests" OFF)

cmake_minimum_required(VERSION 3.13.1)
if (UNIT_TEST)
    include(cmake/coverage.cmake)
else ()
    find_package(Zephyr REQUIRED HINTS $ENV{ZEPHYR_BASE})
endif (UNIT_TEST)

set(CMAKE_CXX_STANDARD 20)
set(CMAKE_C_STANDARD 99)

project(app LANGUAGES C CXX)

include(cmake/git_version.cmake)


###############
# CPM dependencies
###############
add_definitions(-DFMT_HEADER_ONLY=1)
if (NOT DEFINED ENV{CPM_SOURCE_CACHE})
    set(ENV{CPM_SOURCE_CACHE} ${CMAKE_CURRENT_LIST_DIR}/.cpm)
endif ()
include(cmake/CPM.cmake)

CPMAddPackage("gh:boost-ext/di@1.3.0")
CPMAddPackage("gh:aantron/better-enums#0.11.3")
CPMAddPackage("gh:boostorg/circular_buffer#boost-1.76.0")
CPMAddPackage("gh:boostorg/assert#boost-1.76.0")
CPMAddPackage("gh:boostorg/config#boost-1.76.0")
CPMAddPackage("gh:boostorg/concept_check#boost-1.76.0")
CPMAddPackage("gh:boostorg/core#boost-1.76.0")
CPMAddPackage("gh:boostorg/move#boost-1.76.0")
CPMAddPackage("gh:boostorg/preprocessor#boost-1.76.0")
CPMAddPackage("gh:boostorg/static_assert#boost-1.76.0")
CPMAddPackage("gh:boostorg/throw_exception#boost-1.76.0")
CPMAddPackage("gh:boostorg/type_traits#boost-1.76.0")
CPMAddPackage("gh:fmtlib/fmt#10.1.1")
if (UNIT_TEST)
    CPMAddPackage("gh:google/googletest@1.12.0")
endif (UNIT_TEST)

###############
# coriander backend
###############
if (UNIT_TEST)
    set(backend_inc inc/coriander/backends)
    file(GLOB_RECURSE backend_src src/coriander/backends/posix/*.cc)
else (UNIT_TEST)
    set(backend_inc inc/coriander/backends)
    file(GLOB_RECURSE backend_src src/coriander/backends/zephyr/*.cc)
endif (UNIT_TEST)

###############
# coriander core
###############
aux_source_directory(src/coriander sc_src)
aux_source_directory(src/coriander/application sca_src)
aux_source_directory(src/coriander/motorctl scm_src)
aux_source_directory(src/coriander/protos scp_src)
set(coriander_src ${sc_src} ${sca_src} ${scm_src} ${scp_src})
set(coriander_inc inc ${di_SOURCE_DIR}/include ${backend_inc} ${better-enums_SOURCE_DIR} ${fmt_SOURCE_DIR}/include)
set(coriander_lib boost_circular_buffer)
add_library(coriander STATIC ${coriander_src})
target_include_directories(coriander PUBLIC ${coriander_inc})
target_link_libraries(coriander PUBLIC ${coriander_lib})

###############
# app
###############
if (UNIT_TEST)
    aux_source_directory(tests ut_src ${backend_src})
    add_executable(ut ${ut_src})
    add_llvm_cov(ut)
    target_link_libraries(ut PRIVATE gtest_main gmock coriander ${coriander_lib})
    target_include_directories(ut PRIVATE . ${coriander_inc})
else ()
    aux_source_directory(boards/${CONFIG_BOARD} board_src)
    target_sources(app PRIVATE src/main_zephyr.cc ${coriander_src} ${backend_src} ${board_src})
    target_include_directories(app PRIVATE
        inc
        ${coriander_inc})
    target_link_libraries(app PRIVATE ${coriander_lib})
endif (UNIT_TEST)
```

## Kconfig
```
# Copyright (c) 2021 Nordic Semiconductor ASA
# SPDX-License-Identifier: Apache-2.0
#
# This file is the application Kconfig entry point. All application Kconfig
# options can be defined here or included via other application Kconfig files.
# You can browse these options using the west targets menuconfig (terminal) or
# guiconfig (GUI).

menu "Zephyr"
source "Kconfig.zephyr"
endmenu

module = APP
module-str = APP
source "subsys/logging/Kconfig.template.log_config"

rsource "Kconfig.coriander"
```

## Kconfig.coriander
```
config CORIANDER_MINIMAL
    bool "minimal coriander implement"
    default n
    help
        This option enables minimal coriander implement.
        It is used for validate coriander basic function.
        If you want to use coriander as a real firmware,
        please disable this option.
```

## prj.conf
```kconfig
# Copyright (c) 2023 Savent Gate
# SPDX-License-Identifier: All rights reserved.
#
# This file contains selected Kconfig options for the application.

# extend main stack size
CONFIG_MAIN_STACK_SIZE=4096

# Enable C++20 support
CONFIG_CPP=y
CONFIG_STD_CPP20=y
CONFIG_REQUIRES_FULL_LIBCPP=y
CONFIG_GLIBCXX_LIBCPP=y

# Enable CMSIS-DSP
CONFIG_CMSIS_DSP=y
CONFIG_CMSIS_DSP_FASTMATH=y

# Enable logging
CONFIG_LOG=y

# Enable shell
CONFIG_SHELL=y

# diable ability to format filesystem
CONFIG_FILE_SYSTEM_MKFS=n

# Enable sensors
CONFIG_SENSOR=y

# Enable PWM
CONFIG_PWM=y

# Enable PWM capture(not supported on all boards)
CONFIG_PWM_CAPTURE=y
```

## debug.conf
```kconfig
# Copyright (c) 2021 Nordic Semiconductor ASA
# SPDX-License-Identifier: Apache-2.0
#
# This is a Kconfig fragment which can be used to enable debug-related options
# in the application. See the README for more details.

# compiler
CONFIG_DEBUG_OPTIMIZATIONS=y

# segger RTT
CONFIG_USE_SEGGER_RTT=y

# logging in shell
CONFIG_SHELL_LOG_BACKEND=y

CONFIG_JSCOPE_ENABLE=y
```

## perf.conf
```kconfig
# Copyright (c) 2021 Nordic Semiconductor ASA
# SPDX-License-Identifier: Apache-2.0
#
# This is a Kconfig fragment which can be used to enable debug-related options
# in the application. See the README for more details.

# Use systemview to trace the application timing
CONFIG_TRACING=y
CONFIG_USE_SEGGER_RTT=y
CONFIG_SEGGER_SYSTEMVIEW=y
CONFIG_TRACING_BACKEND_RAM=y
CONFIG_SEGGER_SYSTEMVIEW_BOOT_ENABLE=y
CONFIG_SEGGER_SYSVIEW_APP_NAME="coriander"

# Enable jscope
CONFIG_JSCOPE_ENABLE=y
```

## src/main.cc
```c
/*
 * Copyright (c) 2021 Nordic Semiconductor ASA
 * SPDX-License-Identifier: Apache-2.0
 */

#include <app_version.h>
#include <zephyr/drivers/sensor.h>
#include <zephyr/kernel.h>
#include <zephyr/logging/log.h>

#include <boost/di.hpp>

#include "app_version.h"  // NOLINT, this is a generated header in build dir
#include "coriander/application/diagnosis.h"
#include "coriander/base/loggerstream.h"
#include "coriander/base/param.h"
#include "coriander/coriander.h"

// backends
#include "coriander/iprotocol_ctl.h"
#include "zephyr/zephyr_appstatus.h"
#include "zephyr/zephyr_diagnosis.h"
#include "zephyr/zephyr_encoder.h"
#include "zephyr/zephyr_logger.h"
#include "zephyr/zephyr_motor.h"
#include "zephyr/zephyr_mutex.h"
#include "zephyr/zephyr_nvs.h"
#include "zephyr/zephyr_phase_current_estimator.h"
#include "zephyr/zephyr_semaphore.h"
#include "zephyr/zephyr_shell_protocol.h"
#include "zephyr/zephyr_systick.h"
#include "zephyr/zephyr_thread.h"

LOG_MODULE_REGISTER(main);

namespace {

static void loop_hook() { k_sleep(K_MSEC(1)); }

static auto zephyr_backends_bindings() {
  using ILogger = coriander::base::ILogger;
  using IAppStatus = coriander::application::IAppStatus;
  using FocMotorDriver = coriander::motorctl::FocMotorDriver;
  using IBldcDriver = coriander::motorctl::IBldcDriver;
  using IEncoder = coriander::motorctl::IEncoder;
  using ISystick = coriander::os::ISystick;
  using ISemaphore = coriander::os::ISemaphore;
  using IThread = coriander::os::IThread;
  using IMutex = coriander::os::IMutex;
  using IShellCtl = coriander::IShellCtl;
  using BackendAppStatus = coriander::application::zephyr::AppStatus;
  using BackendMotorDriver = coriander::motorctl::zephyr::MotorDriver;
  using IPhaseCurrentEstimator = coriander::motorctl::IPhaseCurrentEstimator;
  using PhaseCurrentEstimator =
      coriander::motorctl::zephyr::PhaseCurrentEstimator;
  return boost::di::make_injector(
      boost::di::bind<ILogger>.to<coriander::base::zephyr::Logger>(),
      boost::di::bind<IAppStatus>.to<BackendAppStatus>(),
      boost::di::bind<FocMotorDriver>.to<BackendMotorDriver>(),
      boost::di::bind<IBldcDriver>.to<BackendMotorDriver>(),
      boost::di::bind<IEncoder>.to<coriander::motorctl::zephyr::Encoder>(),
      boost::di::bind<ISystick>.to<coriander::os::zephyr::Systick>(),
      boost::di::bind<ISemaphore>.to<coriander::os::zephyr::Semaphore>(),
      boost::di::bind<IThread>.to<coriander::os::zephyr::Thread>(),
      boost::di::bind<IMutex>.to<coriander::os::zephyr::Mutex>(),
      boost::di::bind<IPhaseCurrentEstimator>.to<PhaseCurrentEstimator>(),
      boost::di::bind<IShellCtl>.to<coriander::zephyr::ShellProtocol>());
}

static int get_reboot_times() {
  auto nvs = coriander::zephyr::nvs::getInstance();
  int reboot_times = 0;
  bool rc = nvs->read(0, &reboot_times, sizeof(reboot_times));

  if (!rc || reboot_times < 0) {
    LOG_WRN("Unable to read reboot times from nvs, reset to 0");
    reboot_times = 0;
  } else {
    reboot_times++;
  }

  rc = nvs->write(0, &reboot_times, sizeof(reboot_times));
  if (!rc) {
    LOG_ERR("Unable to write reboot times to nvs");
    return -1;
  }

  return reboot_times;
}

static void parameter_default_value_setup(
    std::shared_ptr<coriander::Parameter> param) {
  using Property = coriander::base::Property;
  using ID = coriander::base::ParamId;
  using P = Property;

  static const Property properties[] = {
      P{0, ID::MotorCtl_General_Mode_RT},
      P{1, ID::MotorCtl_MotorDriver_PolePair},
      P{0.0f, ID::MotorCtl_Calibrate_CaliElecAngleOffset},
      P{0.0f, ID::MotorCtl_MotorDriver_PersistRawElecAngle},
      P{0.0f, ID::MotorCtl_MotorDriver_PersistRawMechAngle},
      P{0.0f, ID::MotorCtl_Calibrate_CaliMechAngleOffset},
      P{3.0f, ID::MotorCtl_Calibrate_CaliVoltage},
      P{3000, ID::MotorCtl_Calibrate_CaliDuration},
      P{24.0f, ID::MotorCtl_MotorDriver_SupplyVoltage},
      P{0.0f, ID::MotorCtl_PosCtl_PidP},
      P{0.0f, ID::MotorCtl_PosCtl_PidI},
      P{0.0f, ID::MotorCtl_PosCtl_PidD},
      P{0.0f, ID::MotorCtl_PosCtl_PidOutputRamp},
      P{0.0f, ID::MotorCtl_PosCtl_PidLimit},
      P{2500, ID::MotorCtl_PosCtl_Freq},
      P{0.0f, ID::MotorCtl_General_TargetPosition_RT},
      P{0.0f, ID::MotorCtl_General_TargetVelocity_RT},
      P{0.0f, ID::MotorCtl_SpeedCtl_PidP},
      P{0.0f, ID::MotorCtl_SpeedCtl_PidI},
      P{0.0f, ID::MotorCtl_SpeedCtl_PidD},
      P{0.0f, ID::MotorCtl_SpeedCtl_PidOutputRamp},
      P{0.0f, ID::MotorCtl_SpeedCtl_PidLimit},
      P{10000, ID::MotorCtl_SpeedCtl_Freq},
      P{16, ID::MotorCtl_SpeedEstimator_WindowSize},
      P{1000, ID::MotorCtl_SpeedEstimator_MinDuration},
      P{10, ID::MotorCtl_SpeedEstimator_SampleInterval},
      P{0, ID::Sensor_Mech_Position_RT},
      P{0, ID::Sensor_Mech_Velocity_RT},
      P{0, ID::Sensor_Motor_Current_RT},
      P{0, ID::Sensor_Motor_Temp_RT},
      P{0, ID::Sensor_Motor_Voltage_RT},
      P{1e-3f, ID::MotorCtl_CurrCtl_Lpf_TimeConstant},    // 1KHz
      P{10e-3f, ID::MotorCtl_SpeedCtl_Lpf_TimeConstant},  // 100KHz
      P{100e-3f, ID::MotorCtl_PosCtl_Lpf_TimeConstant},   // 10Hz
  };
  for (auto& p : properties) {
    param->add(p);
  }
}

template <typename T>
static void zephyr_backend_setup(T* injector) {
  auto os = coriander::base::LoggerStream(
      injector->template create<std::shared_ptr<coriander::base::ILogger>>());
  os << "Coriander version " << APP_VERSION_STRING << std::endl;
  os << "Reboot times: " << get_reboot_times() << std::endl;

  auto param =
      injector->template create<std::shared_ptr<coriander::Parameter>>();
  parameter_default_value_setup(param);

  auto diag_regsiter =
      coriander::application::zephyr::DiagnosisRegister::getInstance();
  auto diag = injector->template create<
      std::shared_ptr<coriander::application::Diagnosis>>();
  diag_regsiter->applyAll(diag.get());
}

}  // namespace

int main(void) {
  auto injector =
      coriander::coriander_create_injector(zephyr_backends_bindings());

  zephyr_backend_setup(&injector);

  coriander::coriander_loop(loop_hook, std::move(injector));
  return 0;
}
```

## src/main_zephyr.cc
```c
/*
 * Copyright (c) 2021 Nordic Semiconductor ASA
 * SPDX-License-Identifier: Apache-2.0
 */

#include <app_version.h>
#include <zephyr/drivers/sensor.h>
#include <zephyr/kernel.h>
#include <zephyr/logging/log.h>
#include <zephyr/sys/sem.h>

#include <boost/di.hpp>

#include "app_version.h"  // NOLINT, this is a generated header in build dir
#include "coriander/application/diagnosis.h"
#include "coriander/base/param.h"
#include "coriander/coriander.h"

// backends
#include "coriander/iprotocol_ctl.h"
#include "zephyr/zephyr_appstatus.h"
#include "zephyr/zephyr_diagnosis.h"
#include "zephyr/zephyr_encoder.h"
#include "zephyr/zephyr_logger.h"
#include "zephyr/zephyr_motor.h"
#include "zephyr/zephyr_mutex.h"
#include "zephyr/zephyr_nvs.h"
#include "zephyr/zephyr_persistent_parameter.h"
#include "zephyr/zephyr_phase_current_estimator.h"
#include "zephyr/zephyr_semaphore.h"
#include "zephyr/zephyr_shell_protocol.h"
#include "zephyr/zephyr_systick.h"
#include "zephyr/zephyr_thread.h"

LOG_MODULE_REGISTER(main);

K_SEM_DEFINE(main_wakeup, 0, 1);
static void main_tick_expired(struct k_timer* timer) {
  k_sem_give(&main_wakeup);
}
K_TIMER_DEFINE(main_tick, main_tick_expired, NULL);

// provided by board specific code
extern void board_parameter_default_value_setup(
    std::shared_ptr<coriander::Parameter> param);

namespace {

static void loop_hook() {
  // wait for main loop tick, max wait time is 1ms
  k_sem_take(&main_wakeup, K_MSEC(1));
}

static auto zephyr_backends_bindings() {
  using ILogger = coriander::base::ILogger;
  using IAppStatus = coriander::application::IAppStatus;
  using FocMotorDriver = coriander::motorctl::FocMotorDriver;
  using FocMotorDriverBase = coriander::motorctl::FocMotorDriverBase;
  using IBldcDriver = coriander::motorctl::IBldcDriver;
  using IEncoder = coriander::motorctl::IEncoder;
  using ISystick = coriander::os::ISystick;
  using ISemaphore = coriander::os::ISemaphore;
  using IThread = coriander::os::IThread;
  using IMutex = coriander::os::IMutex;
  using IShellCtl = coriander::IShellCtl;
  using BackendAppStatus = coriander::application::zephyr::AppStatus;
  using BackendMotorDriver = coriander::motorctl::zephyr::MotorDriver;
  // using BackendMotorDriver = coriander::motorctl::zephyr::BldcDriver;
  using IPhaseCurrentEstimator = coriander::motorctl::IPhaseCurrentEstimator;
  using PhaseCurrentEstimator =
      coriander::motorctl::zephyr::PhaseCurrentEstimator;
  using coriander::Parameter;
  using PersistentParameter = coriander::zephyr::PersistentParameter;
  return boost::di::make_injector(
      boost::di::bind<ILogger>.to<coriander::base::zephyr::Logger>(),
      boost::di::bind<IAppStatus>.to<BackendAppStatus>(),
      boost::di::bind<FocMotorDriver>.to<BackendMotorDriver>(),
      boost::di::bind<IBldcDriver>.to<BackendMotorDriver>(),
      boost::di::bind<IEncoder>.to<coriander::motorctl::zephyr::Encoder>(),
      boost::di::bind<ISystick>.to<coriander::os::zephyr::Systick>(),
      boost::di::bind<ISemaphore>.to<coriander::os::zephyr::Semaphore>(),
      boost::di::bind<IThread>.to<coriander::os::zephyr::Thread>(),
      boost::di::bind<IMutex>.to<coriander::os::zephyr::Mutex>(),
      boost::di::bind<IPhaseCurrentEstimator>.to<PhaseCurrentEstimator>(),
      boost::di::bind<Parameter>.to<PersistentParameter>(),
      boost::di::bind<IShellCtl>.to<coriander::zephyr::ShellProtocol>());
}

static int get_reboot_times() {
  auto nvs = coriander::zephyr::nvs::getInstance();
  int reboot_times = 0;
  bool rc = nvs->read(0, &reboot_times, sizeof(reboot_times));

  if (!rc || reboot_times < 0) {
    LOG_WRN("Unable to read reboot times from nvs, reset to 0");
    reboot_times = 0;
  } else {
    reboot_times++;
  }

  rc = nvs->write(0, &reboot_times, sizeof(reboot_times));
  if (!rc) {
    LOG_ERR("Unable to write reboot times to nvs");
    return -1;
  }

  return reboot_times;
}

template <typename T>
static void zephyr_backend_setup(T* injector) {
  auto logger =
      injector->template create<std::shared_ptr<coriander::base::ILogger>>();
  CORIANDER_LOG_INFO(logger, "Coriander version " APP_VERSION_STRING);
  CORIANDER_LOG_INFO(logger, "Reboot times: {}", get_reboot_times());

  auto param =
      injector->template create<std::shared_ptr<coriander::Parameter>>();
  board_parameter_default_value_setup(param);

  auto diag_regsiter =
      coriander::application::zephyr::DiagnosisRegister::getInstance();
  auto diag = injector->template create<
      std::shared_ptr<coriander::application::Diagnosis>>();
  diag_regsiter->applyAll(diag.get());

  // bring up coriander main loop's tick, frequency is 2KHz
  k_timer_start(&main_tick, K_USEC(500), K_USEC(500));
}

}  // namespace

int main(void) {
  auto injector =
      coriander::coriander_create_injector(zephyr_backends_bindings());

  zephyr_backend_setup(&injector);

  coriander::coriander_loop(loop_hook, std::move(injector));
  return 0;
}
```
