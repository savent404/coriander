## boards/arm/td2kw/Kconfig.board
```kconfig
# Copyright (c) 2023 Savent Gate
# SPDX-License-Identifier: All Rights Reserved.

config BOARD_TENGDUN_2KW
    bool "Tengdun 2KW"
    depends on SOC_STM32F405XG
```

## boards/arm/td2kw/Kconfig.defconfig
```kconfig
# Copyright (c) 2023 Savent Gate
# SPDX-License-Identifier: All Rights Reserved.

if BOARD_TENGDUN_2KW

config BOARD
    default "td2kw"

endif # BOARD_TENGDUN_2KW
```

## boards/arm/td2kw/td2kw_defconfig
```kconfig
# SPDX-License-Identifier: Apache-2.0

CONFIG_SOC_SERIES_STM32F4X=y
CONFIG_SOC_STM32F405XG=y

# Enable MPU
CONFIG_ARM_MPU=y

# Enable HW stack protection
CONFIG_HW_STACK_PROTECTION=y

# enable GPIO
CONFIG_GPIO=y

# clock configuration
CONFIG_CLOCK_CONTROL=y

# enable pin controller
CONFIG_PINCTRL=y

# Enable LED
CONFIG_LED=y

# Enable ADC
CONFIG_ADC=y

# Enable SPI-Flash
CONFIG_SPI=y
CONFIG_SPI_STM32_INTERRUPT=y
CONFIG_FLASH=y
CONFIG_SPI_NOR=y
CONFIG_SPI_NOR_FLASH_LAYOUT_PAGE_SIZE=4096

# Enable NVS
CONFIG_NVS=y

# Enable LittleFs
CONFIG_FLASH_MAP=y
CONFIG_FILE_SYSTEM=y
CONFIG_FILE_SYSTEM_MKFS=y
CONFIG_FILE_SYSTEM_LITTLEFS=y
CONFIG_FS_LITTLEFS_FC_HEAP_SIZE=8192

# Enable FPU
CONFIG_FPU=y

# Enable Log-in-fs
CONFIG_LOG_BACKEND_FS=y
CONFIG_LOG_BACKEND_FS_DIR="/fs/logs"
CONFIG_LOG_BACKEND_FS_FILE_SIZE=65535
CONFIG_LOG_BACKEND_FS_FILES_LIMIT=4
```

## dts/bindings/bldc.yaml
```yaml
compatible: "coriander,bldc"
description: |
  a custom bldc driver for coriander

include: base.yaml

properties:
  pwms:
    type: phandle-array
    required: true

  enable-pin:
    type: phandle-array
    specifier-space: gpio
    description: foo
  
  break-pins:
    type: phandle-array
    description: foo
  
  pwm-names:
    type: string-array
    required: false
  
  max_pulse:
    type: int
    required: true

  min_pulse:
    type: int
    required: true
```

## dts/bindings/phase_current.yaml
```yaml
compatible: "coriander,phase_current"
description: |
  using adc io-channel-names: "motor_iu", "motor_iv", "motor_iw" to detect phase current
  actual Current(mA) = (adc(mV) - voltage-offset) / (scale / 1000)

include: base.yaml

properties:
  voltage-offset:
    type: int
    required: true

  voltage-scale:
    type: int
    required: true
```
